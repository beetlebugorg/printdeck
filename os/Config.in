## os/Config.in
```kconfig
source "$BR2_EXTERNAL_PRINTDECK_PATH/package/printdeck-deck/Config.in"
source "$BR2_EXTERNAL_PRINTDECK_PATH/package/klipper-firmware/Config.in"
```

## os/configs/printdeck_defconfig
```kconfig
# Printdeck OS: Raspberry Pi 5, read-only A/B root, systemd.

# Target and toolchain
BR2_aarch64=y
BR2_cortex_a76=y
BR2_TOOLCHAIN_EXTERNAL=y
BR2_TOOLCHAIN_EXTERNAL_BOOTLIN=y
BR2_TOOLCHAIN_EXTERNAL_BOOTLIN_AARCH64_GLIBC_STABLE=y
BR2_GLOBAL_PATCH_DIR="board/raspberrypi/patches"

# System
BR2_TARGET_GENERIC_HOSTNAME="printdeck"
BR2_TARGET_GENERIC_ISSUE="Printdeck"
BR2_INIT_SYSTEMD=y
# Not used: the hardware database (USB and PCI names), the console keymaps and fonts, and timedated.
# BR2_PACKAGE_SYSTEMD_HWDB is not set
# BR2_PACKAGE_SYSTEMD_VCONSOLE is not set
# BR2_PACKAGE_SYSTEMD_TIMEDATED is not set
BR2_ROOTFS_MERGED_USR=y
# BR2_TARGET_ENABLE_ROOT_LOGIN is not set
# BR2_TARGET_GENERIC_GETTY is not set
BR2_SYSTEM_DHCP=""
BR2_TARGET_TZ_INFO=y
BR2_TARGET_LOCALTIME="America/New_York"
BR2_ROOTFS_USERS_TABLES="$(BR2_EXTERNAL_PRINTDECK_PATH)/board/users.txt"
BR2_ROOTFS_OVERLAY="$(BR2_EXTERNAL_PRINTDECK_PATH)/board/rootfs"
BR2_ROOTFS_POST_BUILD_SCRIPT="$(BR2_EXTERNAL_PRINTDECK_PATH)/board/post-build.sh"
BR2_ROOTFS_POST_IMAGE_SCRIPT="$(BR2_EXTERNAL_PRINTDECK_PATH)/board/post-image.sh"
BR2_PACKAGE_BUSYBOX_CONFIG_FRAGMENT_FILES="$(BR2_EXTERNAL_PRINTDECK_PATH)/board/busybox.fragment"

# Kernel: the Raspberry Pi kernel of the Buildroot raspberrypi5_defconfig
BR2_LINUX_KERNEL=y
BR2_LINUX_KERNEL_CUSTOM_TARBALL=y
# The Raspberry Pi kernel, branch rpi-7.2.y (7.2.11).
BR2_LINUX_KERNEL_CUSTOM_TARBALL_LOCATION="$(call github,raspberrypi,linux,61d337138d273f134f41ef06eb0dd97c90123934)/linux-61d337138d273f134f41ef06eb0dd97c90123934.tar.gz"
BR2_LINUX_KERNEL_DEFCONFIG="bcm2712"
BR2_LINUX_KERNEL_CONFIG_FRAGMENT_FILES="board/raspberrypi/linux-4k-page-size.fragment $(BR2_EXTERNAL_PRINTDECK_PATH)/board/linux.fragment"
BR2_LINUX_KERNEL_DTS_SUPPORT=y
BR2_LINUX_KERNEL_INTREE_DTS_NAME="broadcom/bcm2712-rpi-5-b broadcom/bcm2712d0-rpi-5-b"
BR2_LINUX_KERNEL_NEEDS_HOST_OPENSSL=y

# Firmware
BR2_PACKAGE_RPI_FIRMWARE=y
BR2_PACKAGE_RPI_FIRMWARE_INSTALL_DTB_OVERLAYS=y
BR2_PACKAGE_BRCMFMAC_SDIO_FIRMWARE_RPI=y
BR2_PACKAGE_BRCMFMAC_SDIO_FIRMWARE_RPI_WIFI=y
BR2_PACKAGE_WIRELESS_REGDB=y

# Base tools
BR2_PACKAGE_KMOD=y
BR2_PACKAGE_KMOD_TOOLS=y
BR2_PACKAGE_UTIL_LINUX=y
BR2_PACKAGE_UTIL_LINUX_BINARIES=y
BR2_PACKAGE_UTIL_LINUX_PARTX=y
BR2_PACKAGE_E2FSPROGS=y
BR2_PACKAGE_E2FSPROGS_RESIZE2FS=y
BR2_PACKAGE_CA_CERTIFICATES=y
BR2_PACKAGE_SUDO=y

# Network
BR2_PACKAGE_SYSTEMD_NETWORKD=y
BR2_PACKAGE_SYSTEMD_RESOLVED=y
BR2_PACKAGE_SYSTEMD_TIMESYNCD=y
BR2_PACKAGE_WPA_SUPPLICANT=y
BR2_PACKAGE_WPA_SUPPLICANT_NL80211=y
BR2_PACKAGE_WPA_SUPPLICANT_CTRL_IFACE=y
BR2_PACKAGE_WPA_SUPPLICANT_WPA3=y
BR2_PACKAGE_WPA_SUPPLICANT_PASSPHRASE=y
BR2_PACKAGE_DROPBEAR=y

# Printdeck
BR2_PACKAGE_PRINTDECK_DECK=y
BR2_PACKAGE_HOST_GO_BIN=y

# Images
BR2_TARGET_ROOTFS_EROFS=y
BR2_TARGET_ROOTFS_EROFS_LZ4HC=y
# BR2_TARGET_ROOTFS_TAR is not set
BR2_PACKAGE_HOST_DOSFSTOOLS=y
BR2_PACKAGE_HOST_E2FSPROGS=y
BR2_PACKAGE_HOST_GENIMAGE=y
BR2_PACKAGE_HOST_MTOOLS=y
```

## os/package/camilladsp/Config.in
```kconfig
config BR2_PACKAGE_CAMILLADSP
	bool "camilladsp"
	depends on BR2_aarch64
	select BR2_PACKAGE_ALSA_LIB
	help
	  The equalizer between Spotify and the amp. This package installs the aarch64 release binary.

	  https://github.com/HEnquist/camilladsp
```

## os/package/go-librespot/Config.in
```kconfig
config BR2_PACKAGE_GO_LIBRESPOT
	bool "go-librespot"
	depends on BR2_PACKAGE_HOST_GO_TARGET_ARCH_SUPPORTS
	depends on BR2_PACKAGE_HOST_GO_TARGET_CGO_LINKING_SUPPORTS
	select BR2_PACKAGE_HOST_GO
	select BR2_PACKAGE_ALSA_LIB
	select BR2_PACKAGE_FLAC
	select BR2_PACKAGE_LIBOGG
	select BR2_PACKAGE_LIBVORBIS
	select BR2_PACKAGE_MPG123
	help
	  The Spotify Connect player.

	  https://github.com/devgianlu/go-librespot
```

## os/package/klipper-firmware/Config.in
```kconfig
config BR2_PACKAGE_KLIPPER_FIRMWARE
	bool "klipper-firmware"
	help
	  The Klipper firmware for the printer boards, at the Klipper
	  commit of the Go host. The deck flashes it on the board.
```

## os/package/klipper/Config.in
```kconfig
config BR2_PACKAGE_KLIPPER
	bool "klipper"
	depends on BR2_PACKAGE_PYTHON3
	help
	  The Klipper host (klippy). The version must match the firmware on the printer's board.

	  https://www.klipper3d.org
```

## os/package/printdeck-deck/Config.in
```kconfig
config BR2_PACKAGE_PRINTDECK_DECK
	bool "printdeck-deck"
	depends on BR2_PACKAGE_HOST_GO_TARGET_ARCH_SUPPORTS
	select BR2_PACKAGE_HOST_GO
	select BR2_PACKAGE_ALSA_UTILS
	select BR2_PACKAGE_ALSA_UTILS_AMIXER
	help
	  The full screen UI of Printdeck, from deck/ in this repo.
```
